/dts-v1/;
/plugin/;

/ {
    compatible = "brcm,bcm2835";
    fragment@0 {
		target = <&spidev0>;
		__overlay__ {
			status = "disabled";
		};
	};

    fragment@1 {
        target = <&spi0>;
        __overlay__ {
            #address-cells = <1>;
            #size-cells = <0>;
            status = "okay";

            lcd_display: st7735r@0 {
                compatible = "st7735r";
                spi-max-frequency = <32000000>; // Adjusted SPI frequency for your LCD
                reg = <0>;
                width = <160>;
                height = <80>;
                rotation = <270>; // Adjust rotation as needed
                dc-gpios = <&gpio 9 1>; // GPIO pin for D/C (data/command)
                backlight-gpios = <&gpio 12 1>; // GPIO pin for backlight control
                cs-gpios = <&gpio 7 1>; // GPIO pin for CS (chip select), adjust as needed
            };
        };
    };
};
